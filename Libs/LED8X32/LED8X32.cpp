#include "LED8X32.h"



uint8_t zimo_alphabet[][8]={
		{0x00,0x00,0x00,0x00,0x00,0x00,0x00,0x00},/*" ",0*/
		{0x08,0x08,0x08,0x08,0x08,0x00,0x00,0x08},/*"!",1*/
		{0x14,0x14,0x28,0x00,0x00,0x00,0x00,0x00},/*""",2*/
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		{0x7C,0x48,0x08,0x10,0x10,0x20,0x24,0x7C},/*"Z",58*/
};

LED8X32::LED8X32(uint8_t cs,uint8_t  wr, uint8_t data)
{
	this->cs_pin=cs;
	this->data_pin=data;
	this->wr_pin=wr;
	this->time_interval=500;
	this->start_moment=0;
	this->ptr=0;
	this->string=NULL;
	this->length=0;
	this->repeat_type=true;
}

void LED8X32::HT1632C_Writer(unsigned char Data,unsigned char cnt)	  
{
	unsigned char i;
	for(i=0;i<cnt;i++)
	{
  		digitalWrite(this->wr_pin, LOW);
		if(Data&0x80)
		digitalWrite(this->data_pin, HIGH);
		else
		digitalWrite(this->data_pin, LOW);
		Data<<=1;
		digitalWrite(this->wr_pin, HIGH);
	}
}
void LED8X32::HT1632C_Writer_CMD(unsigned char cmd)//
{
	digitalWrite(this->cs_pin, LOW);
	LED8X32::HT1632C_Writer(0x80,3);		//
	LED8X32::HT1632C_Writer(cmd,9);		//
	digitalWrite(this->cs_pin, HIGH);
}
void LED8X32::HT1632C_Writer_AllDATA(unsigned char Addr,unsigned char p[],unsigned char cnt)//
{
	unsigned char i;
	digitalWrite(this->cs_pin, LOW);
	LED8X32::HT1632C_Writer(0xa0,3);
	LED8X32::HT1632C_Writer(Addr<<1,7);
#ifdef REVERSE
	p=p+7;
	for(i=0;i<cnt;i++)
		{
		LED8X32::HT1632C_Writer(*p,8);
			p--;
		}
	digitalWrite(this->cs_pin, HIGH);
#else
	for(i=0;i<cnt;i++)
		{
		LED8X32::HT1632C_Writer(*p,8);
			p++;
		}
	digitalWrite(this->cs_pin, HIGH);
#endif
}

void LED8X32::HT1632C_clr(void)
{
	unsigned char i;
	digitalWrite(this->cs_pin, LOW);
	HT1632C_Writer(0xa0,3);
	LED8X32::HT1632C_Writer(0x00,7);
	for(i=0;i<32;i++)
		LED8X32::HT1632C_Writer(0x00,8);
	digitalWrite(this->cs_pin, HIGH);

	this->string=NULL;
	this->length=0;
	this->start_moment=0;
	this->ptr=0;
}
void LED8X32::HT1632C_Init(void)		
{
	pinMode(this->cs_pin, OUTPUT);
	pinMode(this->wr_pin, OUTPUT);
//	pinMode(RD, OUTPUT);
	pinMode(this->data_pin, OUTPUT);
	digitalWrite(this->cs_pin, HIGH);
	digitalWrite(this->wr_pin, HIGH);
//	digitalWrite(RD, HIGH);
	digitalWrite(this->data_pin, HIGH);
	HT1632C_Writer_CMD(SYS_DIS);
	HT1632C_Writer_CMD(COM_OPTION);
	HT1632C_Writer_CMD(RC_MASTER_MODE);
//	HT1632C_Writer_CMD(SLAVE_MODE);
	HT1632C_Writer_CMD(SYS_EN);
	HT1632C_Writer_CMD(LED_ON);
//	HT1632C_Writer_CMD(PWM_DUTY);
	HT1632C_Writer_CMD(BLINK_OFF);
//	HT1632C_Writer_CMD(BLINK_ON);
}

void LED8X32::HT1632C_show_string(uint8_t *string, uint8_t lenth, bool repeat=true, uint16_t ms)
{
	this->string=string;
	this->length=lenth;
	this->repeat_type=repeat;
	this->time_interval=ms;
	this->start_moment=millis();
}

void LED8X32::HT1632C_show_handle()
{
if(this->string!=NULL && this->length)
	{

		if(millis()-this->start_moment>=this->time_interval)
		{
			this->start_moment=millis();
			if(this->ptr+3>=this->length)
			{
				if(this->repeat_type)
				{
					this->ptr=0;
				}
				else
				{
					this->HT1632C_clr();
				}
			}
			else
			{
				this->HT1632C_Writer_AllDATA(0 , zimo_alphabet[*(this->string+this->ptr+0)-' '], 8);
				this->HT1632C_Writer_AllDATA(16, zimo_alphabet[*(this->string+this->ptr+1)-' '], 8);
				this->HT1632C_Writer_AllDATA(32, zimo_alphabet[*(this->string+this->ptr+2)-' '], 8);
				this->HT1632C_Writer_AllDATA(48, zimo_alphabet[*(this->string+this->ptr+3)-' '], 8);
				this->ptr++;

			}

		}
	}

}
LED8X32::~LED8X32()
{

}
